// SPDX-License-Identifier: (GPL-2.0+ OR MIT)
/*
 * Copyright (c) 2025 Radxa Computer (Shenzhen) Co., Ltd.
 */

#include "rk3588s-u-boot.dtsi"

&sdhci {
	mmc-hs200-1_8v;
};

&usb_host0_xhci {
	maximum-speed = "high-speed";
};
